## drivers/lora/Kconfig.mock
```kconfig
# Mock LoRa driver for simulation
config LORA_MOCK
    bool "Mock LoRa driver"
    depends on LORA
    help
      Enable mock LoRa driver for simulation and testing purposes.
      This driver simulates LoRa operations without actual hardware.

if LORA_MOCK

config LORA_MOCK_INIT_PRIORITY
    int "Mock LoRa driver init priority"
    default 80
    help
      Mock LoRa driver initialization priority.

endif # LORA_MOCK
```

## tests/auth/testcase.yaml
```yaml
tests:
  terrascope.auth:
    tags: auth security
    platform_allow: qemu_riscv64
```

## tests/cbor/testcase.yaml
```yaml
tests:
  terrascope.cbor:
    tags: cbor serialization
    platform_allow: qemu_riscv64
```

## tests/config/testcase.yaml
```yaml
tests:
  terrascope.config:
    tags: config settings
    platform_allow: qemu_riscv64
```

## tests/contention/testcase.yaml
```yaml
tests:
  terrascope.contention:
    tags: contention mesh lora
    platform_allow: qemu_riscv64
```

## tests/routing/testcase.yaml
```yaml
tests:
  terrascope.routing:
    tags: routing mesh
    platform_allow: qemu_riscv64
```

## tests/routing_table/testcase.yaml
```yaml
tests:
  terrascope.routing_table:
    tags: routing mesh
    platform_allow: qemu_riscv64
```
